/ {
     soc{
          interrupt-controller@40041000 {
			interrupt-controller;
			#interrupt-cells = <0x03>;
			compatible = "arm,gic-400";
			reg = <0x40041000 0x1000 0x40042000 0x2000 0x40044000 0x2000 0x40046000 0x2000>;
			interrupts = <0x01 0x09 0xf04>;
			phandle = <0x01>;
		};
     };

     chosen {
		stdout-path = "serial0:115200n8";
		bootargs = "console=ttyS0,115200 earlycon=uart8250,mmio32,0xfe215040 debug loglevel=8";
          linux,stdout-path = "serial0:115200n8";
          linux,initrd-start = <0x2d700000>;
          linux,initrd-end = <0x2f000000>;
	};
};
